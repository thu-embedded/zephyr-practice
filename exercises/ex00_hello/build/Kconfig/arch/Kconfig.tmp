## exercises/ex00_hello/build/Kconfig/arch/Kconfig.tmp
```kconfig
# Load Zephyr Arch Kconfig descriptions.
osource "/home/thule/zephyrproject/zephyr/arch/rx/Kconfig"
osource "/home/thule/zephyrproject/zephyr/arch/x86/Kconfig"
osource "/home/thule/zephyrproject/zephyr/arch/xtensa/Kconfig"
osource "/home/thule/zephyrproject/zephyr/arch/sparc/Kconfig"
osource "/home/thule/zephyrproject/zephyr/arch/riscv/Kconfig"
osource "/home/thule/zephyrproject/zephyr/arch/posix/Kconfig"
osource "/home/thule/zephyrproject/zephyr/arch/openrisc/Kconfig"
osource "/home/thule/zephyrproject/zephyr/arch/mips/Kconfig"
osource "/home/thule/zephyrproject/zephyr/arch/arm64/Kconfig"
osource "/home/thule/zephyrproject/zephyr/arch/arm/Kconfig"
osource "/home/thule/zephyrproject/zephyr/arch/arc/Kconfig"
```

## exercises/ex00_hello/build/Kconfig/boards/Kconfig
```kconfig
# Load Zephyr board Kconfig descriptions.
osource "/home/thule/zephyrproject/zephyr/boards/qemu/cortex_m3/Kconfig"
```

## exercises/ex00_hello/build/Kconfig/boards/Kconfig.defconfig.tmp
```kconfig
# Load Zephyr board defconfig descriptions.
osource "/home/thule/zephyrproject/zephyr/boards/qemu/cortex_m3/Kconfig.defconfig"
```

## exercises/ex00_hello/build/Kconfig/boards/Kconfig.qemu_cortex_m3
```kconfig
# Load board Kconfig descriptions.
osource "/home/thule/zephyrproject/zephyr/boards/qemu/cortex_m3/Kconfig.qemu_cortex_m3"
```

## exercises/ex21_ci/testcase.yaml
```yaml
tests:
  exercises.ex21_ci:
    tags: ci ztest
    platform_allow:
      - qemu_cortex_m3
      - native_sim
    harness: ztest
    harness_config:
      type: one_line
      regex:
        - "TESTSUITE ci_demo succeeded"
```

## west.yml
```yaml
manifest:
  self:
    path: zephyr-practice

  projects:
    - name: zephyr
      url: https://github.com/zephyrproject-rtos/zephyr
      path: zephyr
      west-commands: scripts/west-commands.yml
```
